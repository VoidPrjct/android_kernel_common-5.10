## block/Kconfig.iosched
```kconfig
# SPDX-License-Identifier: GPL-2.0
if BLOCK

menu "IO Schedulers"

config MQ_IOSCHED_SCARLET
	tristate "Scarlet hybrid I/O scheduler"
	default y
	help
	  Scarlet is the only I/O scheduler built by this kernel. It combines
	  the per-domain FIFOs of kyber, the deadline expiry and request
	  merging of mq-deadline, and the latency-driven adaptive queue depth
	  of kyber/ADIOS.

	  If unsure, say Y.

config IOSCHED_SCARLET_DEFAULT
	bool "Use Scarlet as the default I/O scheduler"
	depends on MQ_IOSCHED_SCARLET
	default y
	help
	  Select Scarlet for every block device at probe time. Upstream only
	  applies a default scheduler to single-queue devices, which leaves
	  multi-queue devices such as UFS without one; this option removes
	  that restriction.

config IOSCHED_SCARLET_LOCK
	bool "Lock Scarlet as the only selectable I/O scheduler"
	depends on MQ_IOSCHED_SCARLET
	default y
	help
	  Refuse writes to /sys/block/*/queue/scheduler that would switch a
	  queue away from Scarlet. The lock can still be released at boot with
	  scarlet_iosched=nolock on the kernel command line or in bootconfig.

endmenu

endif
```
